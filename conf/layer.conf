## conf/layer.conf
```bitbake
# We have a conf and classes directory, add to BBPATH
BBPATH .= ":${LAYERDIR}"

# We have a recipes-* directories, add to BBFILES
BBFILES += "${LAYERDIR}/recipes-*/*/*.bb \
	${LAYERDIR}/recipes-*/*/*.bbappend"

BBFILE_COLLECTIONS += "toradex-tegra-layer"
BBFILE_PATTERN_toradex-tegra-layer = "^${LAYERDIR}/"
BBFILE_PRIORITY_toradex-tegra-layer = "90"

# Let us add layer-specific bbappends which are only applied when that
# layer is included in our configuration
BBFILES += "${@' '.join('${LAYERDIR}/%s/recipes*/*/*.bbappend' % layer \
               for layer in BBFILE_COLLECTIONS.split())}"
# Add layer-specific bb files too
BBFILES += "${@' '.join('${LAYERDIR}/%s/recipes*/*/*.bb' % layer \
               for layer in BBFILE_COLLECTIONS.split())}"
```

## conf/machine/apalis-t30.conf
```bitbake
#@TYPE: Machine
#@NAME: apalis_t30
#@DESCRIPTION: Toradex Apalis T30

require conf/machine/include/tegra-base.inc

SOC_FAMILY = "tegra:tegra3"

UBOOT_MACHINE = "apalis_t30_defconfig"
UBOOT_ENTRYPOINT = "0x82008000"
UBOOT_LOADADDRESS = "${UBOOT_ENTRYPOINT}"

PREFERRED_PROVIDER_lxde-icon-theme_apalis-t30 = "lxde-icon-theme"
PREFERRED_PROVIDER_lxsession-lite_apalis-t30 = "lxsession"
PREFERRED_PROVIDER_virtual/psplash = "psplash-angstrom"
PREFERRED_PROVIDER_psplash-support = "psplash-angstrom"

MACHINE_FEATURES = "screen usbgadget usbhost vfat ext2 alsa touchscreen wifi bluetooth 3g pci "
EXTRA_IMAGEDEPENDS += "u-boot"

# used by sysvinit_2
SERIAL_CONSOLE = "115200 ttyS0"
IMAGE_FSTYPES ?= "tar.xz"

DEFAULTTUNE = "armv7athf-neon"
require conf/machine/include/tune-cortexa9.inc
```

## conf/machine/apalis-tk1-mainline.conf
```bitbake
#@TYPE: Machine
#@NAME: apalis-tk1-mainline
#@DESCRIPTION: Toradex Apalis TK1 Mainline

#require conf/machine/include/tegra-base.inc
require conf/machine/include/soc-family.inc

SOC_FAMILY = "tegra124m"

PREFERRED_PROVIDER_virtual/kernel = "linux-toradex-mainline"

KERNEL_IMAGETYPE = "uImage"
KERNEL_DEFCONFIG = "tegra_defconfig"
KERNEL_DEVICETREE += "tegra124-apalis-eval.dtb"

PREFERRED_PROVIDER_u-boot = "u-boot-toradex"
PREFERRED_PROVIDER_virtual/bootloader = "u-boot-toradex"
UBOOT_MACHINE = "apalis-tk1_defconfig"
UBOOT_ENTRYPOINT = "0x80008000"
UBOOT_LOADADDRESS = "${UBOOT_ENTRYPOINT}"

PREFERRED_PROVIDER_lxde-icon-theme_apalis-tk1-mainline = "lxde-icon-theme"
PREFERRED_PROVIDER_lxsession-lite_apalis-tk1-mainline = "lxsession"
PREFERRED_PROVIDER_virtual/psplash = "psplash-angstrom"
PREFERRED_PROVIDER_psplash-support = "psplash-angstrom"

PREFERRED_PROVIDER_virtual/xserver ?= "xserver-xorg"
PREFERRED_VERSION_xserver-xorg_tegra124m = "99:1.18%"
PREFERRED_PROVIDER_virtual/mesa ?= "mesa"
PREFERRED_PROVIDER_virtual/libgl ?= "mesa"

GALLIUMDRIVERS_append_armv7a =",nouveau"
XSERVER ?= "xserver-xorg \
            mesa-driver-nouveau \
            xf86-input-evdev \
            xf86-input-keyboard \
            xf86-input-mouse \
            xf86-video-modesetting \
           "

MACHINE_FEATURES = "screen usbgadget usbhost vfat ext2 alsa touchscreen wifi bluetooth 3g pci "
MACHINE_EXTRA_RDEPENDS = "linux-firmware-nvidia"
EXTRA_IMAGEDEPENDS += "u-boot"

# used by sysvinit_2
SERIAL_CONSOLE = "115200 ttyS0"
IMAGE_FSTYPES ?= "tar.bz2"

DEFAULTTUNE = "cortexa15hf-neon"
require conf/machine/include/tune-cortexa15.inc
```

## conf/machine/apalis-tk1.conf
```bitbake
#@TYPE: Machine
#@NAME: apalis-tk1
#@DESCRIPTION: Toradex Apalis TK1

#require conf/machine/include/tegra-base.inc
require conf/machine/include/soc-family.inc

SOC_FAMILY = "tegra124"

PREFERRED_PROVIDER_virtual/kernel = "linux-toradex"

KERNEL_IMAGETYPE = "uImage"
KERNEL_DEVICETREE += "tegra124-apalis-eval.dtb"

PREFERRED_PROVIDER_u-boot = "u-boot-toradex"
PREFERRED_PROVIDER_virtual/bootloader = "u-boot-toradex"
UBOOT_MACHINE = "apalis-tk1_defconfig"
UBOOT_ENTRYPOINT = "0x80008000"
UBOOT_LOADADDRESS = "${UBOOT_ENTRYPOINT}"
KEEPUIMAGE = ""

PREFERRED_PROVIDER_lxde-icon-theme_apalis-tk1 = "lxde-icon-theme"
PREFERRED_PROVIDER_lxsession-lite_apalis-tk1 = "lxsession"
PREFERRED_PROVIDER_virtual/psplash = "psplash-angstrom"
PREFERRED_PROVIDER_psplash-support = "psplash-angstrom"

PREFERRED_PROVIDER_virtual/xserver ?= "xserver-xorg"
PREFERRED_PROVIDER_virtual/mesa ?= "mesa"
PREFERRED_PROVIDER_virtual/libgl ?= "mesa"

#xf86-video-nouveau
#our fs-init may conflict with linux-driver-package-firstboot
XSERVER ?= "xserver-xorg \
            linux-driver-package \
            linux-driver-package-boot \
            linux-driver-package-firmware \
            linux-driver-package-firstboot \
            mesa-driver-swrast \
            xf86-input-evdev \
            xf86-input-keyboard \
            xf86-input-mouse \
            xf86-video-modesetting \
           "

MACHINE_FEATURES = "screen usbgadget usbhost vfat ext2 alsa touchscreen wifi bluetooth 3g pci "
EXTRA_IMAGEDEPENDS += "u-boot"

# used by sysvinit_2
SERIAL_CONSOLE = "115200 ttyS0"
IMAGE_FSTYPES ?= "tar.bz2"

DEFAULTTUNE = "cortexa15hf-neon"
require conf/machine/include/tune-cortexa15.inc
```

## conf/machine/include/tegra-base.inc
```bitbake
# Provides common Tegra SoC settings

require conf/machine/include/soc-family.inc

# Tegra binaries require a specific X-Server binary ABI
PREFERRED_PROVIDER_virtual/xserver_tegra = "xserver-xorg"
PREFERRED_VERSION_xserver-xorg_tegra = "99:1.14%"
XSERVER = "xserver-xorg \
           xf86-input-evdev \
           xf86-input-mouse \
           xf86-video-fbdev \
           xf86-input-keyboard"

PREFERRED_PROVIDER_virtual/kernel = "linux-toradex"
KERNEL_IMAGETYPE = "uImage"
# The kernel lives in a seperate FAT or UBI partition, don't deploy it in /boot
RDEPENDS_kernel-base = ""

PREFERRED_PROVIDER_u-boot = "u-boot-toradex"
PREFERRED_PROVIDER_virtual/bootloader = "u-boot-toradex"

# require u-boot-dtb-tegra.bin to be used
UBOOT_IMAGE = "u-boot-dtb-tegra-${MACHINE}-${PV}-${PR}.${UBOOT_SUFFIX}"
UBOOT_BINARY = "u-boot-dtb-tegra.${UBOOT_SUFFIX}"
UBOOT_SYMLINK = "u-boot-dtb-tegra-${MACHINE}.${UBOOT_SUFFIX}"

PREFERRED_PROVIDER_virtual/mesa = "mesa"
PREFERRED_PROVIDER_virtual/egl = "tdx-nv-binaries"
PREFERRED_PROVIDER_virtual/libgles1 = "tdx-nv-binaries"
PREFERRED_PROVIDER_virtual/libgles2 = "tdx-nv-binaries"

# Install NV binaries which contains tegra X-Server drivers when X11 is chosen
MACHINE_EXTRA_RRECOMMENDS_append_tegra = " ${@bb.utils.contains('DISTRO_FEATURES', 'x11', 'tdx-nv-binaries', '', d)}"
```
